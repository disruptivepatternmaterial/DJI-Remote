#ifdef M5STICKC_PLUS_11
/*
 * M5Stick C Plus 1.1 HAL – implements m5stack_basic_v27_* API for 135x240 display.
 * Pins per M5Stack docs: DC=23, RST=18, MOSI=15, SCLK=13, CS=5. Buttons A=37, B=39, PWR=35.
 * Logical UI is 320x240; we scale X by 135/320 to fit 135x240 physical.
 */

#include "m5stickc_plus11_hal.h"
#include "driver/gpio.h"
#include "driver/spi_master.h"
#include "esp_log.h"
#include "freertos/FreeRTOS.h"
#include "freertos/task.h"
#include <string.h>
#include "esp_heap_caps.h"
#include "esp_lcd_panel_io.h"
#include "esp_lcd_panel_vendor.h"
#include "esp_lcd_panel_ops.h"

/* M5Stick C Plus 1.1 pinout (official docs) */
#define LCD_MOSI_PIN  15
#define LCD_SCLK_PIN  13
#define LCD_CS_PIN    5
#define LCD_DC_PIN    23
#define LCD_RST_PIN   18
#define LCD_BL_PIN    (-1)   /* Plus 1.1 uses AXP192 LDO2 for backlight */
#define BTN_A_PIN     37
#define BTN_B_PIN     39
#define BTN_C_PIN     35     /* Power button as "C" */
#define PWR_EN_PIN    4      /* Optional power hold */

#define PHYS_W  135
#define PHYS_H  240
#define LOG_W   320
#define LOG_H   240

#define SCALE_X(x)   ((int)((x) * (long)PHYS_W / LOG_W))
#define SCALE_W(w)   ((int)((w) * (long)PHYS_W / LOG_W) > 0 ? (int)((w) * (long)PHYS_W / LOG_W) : 1)

static const char *TAG = "STICK_PLUS11";
static esp_lcd_panel_handle_t panel_handle = NULL;
static esp_lcd_panel_io_handle_t io_handle = NULL;

static void draw_char_scaled(int x, int y, char c, uint16_t color, int scale);

/* Minimal 8x8 font (space through 'z') */
static const uint8_t font8x8_plus11[][8] = {
    {0x00,0x00,0x00,0x00,0x00,0x00,0x00,0x00},
    {0x18,0x3C,0x3C,0x18,0x18,0x00,0x18,0x00},
    {0x00,0x00,0x00,0x00,0x00,0x00,0x00,0x00},{0x00,0x00,0x00,0x00,0x00,0x00,0x00,0x00},{0x00,0x00,0x00,0x00,0x00,0x00,0x00,0x00},{0x00,0x00,0x00,0x00,0x00,0x00,0x00,0x00},{0x00,0x00,0x00,0x00,0x00,0x00,0x00,0x00},{0x00,0x00,0x00,0x00,0x00,0x00,0x00,0x00},
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    {0x00,0x00,0x66,0x66,0x66,0x3E,0x06,0x3C},{0x00,0x00,0x7E,0x0C,0x18,0x30,0x7E,0x00},
};

int m5stack_basic_v27_power_init(void) {
    gpio_config_t pwr = {
        .intr_type = GPIO_INTR_DISABLE,
        .mode = GPIO_MODE_OUTPUT,
        .pin_bit_mask = (1ULL << PWR_EN_PIN),
        .pull_down_en = 0, .pull_up_en = 0,
    };
    gpio_config(&pwr);
    gpio_set_level(PWR_EN_PIN, 1);
    return 0;
}

int m5stack_basic_v27_display_init(void) {
    gpio_config_t rst = {
        .intr_type = GPIO_INTR_DISABLE, .mode = GPIO_MODE_OUTPUT,
        .pin_bit_mask = (1ULL << LCD_RST_PIN), .pull_down_en = 0, .pull_up_en = 0,
    };
    gpio_config(&rst);
    gpio_config_t dc = {
        .intr_type = GPIO_INTR_DISABLE, .mode = GPIO_MODE_OUTPUT,
        .pin_bit_mask = (1ULL << LCD_DC_PIN), .pull_down_en = 0, .pull_up_en = 0,
    };
    gpio_config(&dc);
    gpio_config_t cs = {
        .intr_type = GPIO_INTR_DISABLE, .mode = GPIO_MODE_OUTPUT,
        .pin_bit_mask = (1ULL << LCD_CS_PIN), .pull_down_en = 0, .pull_up_en = 0,
    };
    gpio_config(&cs);
    gpio_set_level(LCD_CS_PIN, 1);
    gpio_set_level(LCD_RST_PIN, 0);
    vTaskDelay(pdMS_TO_TICKS(10));
    gpio_set_level(LCD_RST_PIN, 1);
    vTaskDelay(pdMS_TO_TICKS(10));

    spi_bus_config_t buscfg = {
        .mosi_io_num = LCD_MOSI_PIN, .miso_io_num = -1, .sclk_io_num = LCD_SCLK_PIN,
        .quadwp_io_num = -1, .quadhd_io_num = -1, .max_transfer_sz = 4096,
    };
    esp_err_t ret = spi_bus_initialize(VSPI_HOST, &buscfg, 1);
    if (ret != ESP_OK) return ret;

    esp_lcd_panel_io_spi_config_t io_config = {
        .dc_gpio_num = LCD_DC_PIN, .cs_gpio_num = LCD_CS_PIN,
        .pclk_hz = 26 * 1000 * 1000, .lcd_cmd_bits = 8, .lcd_param_bits = 8,
        .spi_mode = 0, .trans_queue_depth = 10,
    };
    ret = esp_lcd_new_panel_io_spi((esp_lcd_spi_bus_handle_t)VSPI_HOST, &io_config, &io_handle);
    if (ret != ESP_OK) return ret;

    esp_lcd_panel_dev_config_t panel_config = {
        .reset_gpio_num = LCD_RST_PIN, .color_space = ESP_LCD_COLOR_SPACE_BGR,
        .bits_per_pixel = 16, .flags = { .reset_active_high = 0 }, .vendor_config = NULL,
    };
    ret = esp_lcd_new_panel_st7789(io_handle, &panel_config, &panel_handle);
    if (ret != ESP_OK) return ret;
    esp_lcd_panel_reset(panel_handle);
    esp_lcd_panel_init(panel_handle);
    esp_lcd_panel_invert_color(panel_handle, true);
    esp_lcd_panel_swap_xy(panel_handle, true);
    esp_lcd_panel_mirror(panel_handle, false, true);
    esp_lcd_panel_set_gap(panel_handle, 40, 52);
    esp_lcd_panel_disp_on_off(panel_handle, true);
    m5stack_basic_v27_display_clear(M5_COLOR_BLACK);
    return 0;
}

int m5stack_basic_v27_buttons_init(void) {
    gpio_config_t io = {
        .intr_type = GPIO_INTR_DISABLE, .mode = GPIO_MODE_INPUT,
        .pin_bit_mask = (1ULL << BTN_A_PIN) | (1ULL << BTN_B_PIN) | (1ULL << BTN_C_PIN),
        .pull_down_en = 0, .pull_up_en = 0,
    };
    gpio_config(&io);
    return 0;
}

int m5stack_basic_v27_init(void) {
    m5stack_basic_v27_power_init();
    m5stack_basic_v27_display_init();
    m5stack_basic_v27_buttons_init();
    return 0;
}

bool m5stack_basic_v27_button_a_pressed(void) { return gpio_get_level(BTN_A_PIN) == 0; }
bool m5stack_basic_v27_button_b_pressed(void) { return gpio_get_level(BTN_B_PIN) == 0; }
bool m5stack_basic_v27_button_c_pressed(void) { return gpio_get_level(BTN_C_PIN) == 0; }
void m5stack_basic_v27_display_set_brightness(uint8_t brightness) { (void)brightness; }
esp_lcd_panel_handle_t m5stack_basic_v27_get_display_handle(void) { return panel_handle; }

void m5stack_basic_v27_display_clear(uint16_t color) {
    if (!panel_handle) return;
    const int ch = 30;
    int total = PHYS_W * ch;
    uint16_t *buf = malloc(total * sizeof(uint16_t));
    if (!buf) return;
    for (int i = 0; i < total; i++) buf[i] = color;
    for (int y = 0; y < PHYS_H; y += ch) {
        int h = (y + ch > PHYS_H) ? (PHYS_H - y) : ch;
        esp_lcd_panel_draw_bitmap(panel_handle, 0, y, PHYS_W, y + h, buf);
    }
    free(buf);
}

void m5stack_basic_v27_display_show_boot_logo(void) {
    m5stack_basic_v27_display_clear(M5_COLOR_BLACK);
}

static void draw_char_scaled(int x, int y, char c, uint16_t color, int scale) {
    if (!panel_handle) return;
    int idx = (c >= ' ' && c <= 'z') ? (c - ' ') : 0;
    for (int row = 0; row < 8; row++) {
        uint8_t line = font8x8_plus11[idx][row];
        for (int col = 0; col < 8; col++) {
            if (line & (0x80 >> col)) {
                for (int sy = 0; sy < scale; sy++)
                    for (int sx = 0; sx < scale; sx++) {
                        int px = SCALE_X(x + col * scale + sx);
                        int py = y + row * scale + sy;
                        if (px < PHYS_W && py < PHYS_H)
                            esp_lcd_panel_draw_bitmap(panel_handle, px, py, px + 1, py + 1, &color);
                    }
            }
        }
    }
}

void m5stack_basic_v27_display_print(int x, int y, const char *text, uint16_t color) {
    m5stack_basic_v27_display_print_scaled(x, y, text, color, 1);
}

void m5stack_basic_v27_display_print_scaled(int x, int y, const char *text, uint16_t color, int scale) {
    if (!panel_handle || !text) return;
    int cx = x, cy = y, cw = 8 * scale, ch = 8 * scale, sp = ch + 2;
    for (const char *p = text; *p; p++) {
        if (*p == '\n') { cx = x; cy += sp; continue; }
        draw_char_scaled(cx, cy, *p, color, scale);
        cx += cw;
        if (SCALE_X(cx) > PHYS_W - SCALE_W(cw)) { cx = x; cy += sp; }
    }
}

void m5stack_basic_v27_display_draw_bitmap(int x, int y, int width, int height, const uint8_t *bitmap, uint16_t color, uint16_t bg_color) {
    if (!panel_handle || !bitmap) return;
    int px = SCALE_X(x), py = y, pw = SCALE_W(width), ph = height;
    if (px >= PHYS_W || py >= PHYS_H || pw < 1 || ph < 1) return;
    int byte_width = (width + 7) / 8;
    for (int row = 0; row < height && (py + row) < PHYS_H; row++) {
        for (int col = 0; col < width; col++) {
            int pcol = SCALE_X(x + col);
            if (pcol >= PHYS_W) continue;
            int by = row * byte_width + col / 8, bi = 7 - (col % 8);
            uint16_t pixel_color = ((bitmap[by] >> bi) & 1) ? color : bg_color;
            esp_lcd_panel_draw_bitmap(panel_handle, pcol, py + row, pcol + 1, py + row + 1, &pixel_color);
        }
    }
}

void m5stack_basic_v27_display_fill_circle(int x, int y, int radius, uint16_t color) {
    int size = radius * 2;
    m5stack_basic_v27_display_fill_rect(x - radius, y - radius, size, size, color);
}

void m5stack_basic_v27_display_fill_rect(int x, int y, int width, int height, uint16_t color) {
    if (!panel_handle) return;
    int px = SCALE_X(x), py = y, pw = SCALE_W(width), ph = height;
    if (px >= PHYS_W || py >= PHYS_H) return;
    if (px + pw > PHYS_W) pw = PHYS_W - px;
    if (py + ph > PHYS_H) ph = PHYS_H - py;
    if (pw <= 0 || ph <= 0) return;
    size_t sz = (size_t)pw * ph * sizeof(uint16_t);
    uint16_t *buf = heap_caps_malloc(sz, MALLOC_CAP_DMA);
    if (!buf) return;
    for (int i = 0; i < pw * ph; i++) buf[i] = color;
    esp_lcd_panel_draw_bitmap(panel_handle, px, py, px + pw, py + ph, buf);
    heap_caps_free(buf);
}

#endif /* M5STICKC_PLUS_11 */
